## drivers/Kconfig
```kconfig
menu "Hardware Drivers Config"

config SOC_IMX6ULL
    bool
    select RT_USING_COMPONENTS_INIT
    select RT_USING_USER_MAIN
    default y

menu "Onboard Peripheral Drivers"

    config BSP_USING_GPIO
        bool "Enable GPIO"
        default n

    menuconfig BSP_USING_UART
        bool "Enable UART"
        select RT_USING_SERIAL
        default n
        if BSP_USING_UART
            config BSP_USING_UART1
            bool "Enable UART1"
            default n

            config BSP_USING_UART2
            bool "Enable UART2"
            default n
        endif

    menuconfig BSP_USING_ADC
        bool "Enable ADC"
        select RT_USING_ADC
        default n
        if BSP_USING_ADC
            config BSP_USING_ADC1
            bool "Enable ADC1"
            default n

            config BSP_USING_ADC2
            bool "Enable ADC2"
            default n
        endif

    menuconfig BSP_USING_DAC
        bool "Enable DAC"
        select RT_USING_DAC
        default n
        if BSP_USING_DAC
            config BSP_USING_DAC1
            bool "Enable DAC1"
            default n

            config BSP_USING_DAC2
            bool "Enable DAC2"
            default n
        endif

    menuconfig BSP_USING_RTC
        bool "Enable RTC"
        select RT_USING_RTC
        default n

    menuconfig BSP_USING_WDT
        bool "Enable RTC"
        select RT_USING_WDT
        default n

    menuconfig BSP_USING_I2C
        bool "Enable I2C BUS"
        default n
        select RT_USING_I2C
        if BSP_USING_I2C
            config BSP_USING_I2C1
                bool "Enable I2C1 BUS"
                default n

            config BSP_USING_I2C2
                bool "Enable I2C2 BUS"
                default n
        endif

    menuconfig BSP_USING_SPI
        bool "Enable SPI BUS"
        default n
        select RT_USING_SPI
        if BSP_USING_SPI
            config BSP_USING_SPI1
                bool "Enable SPI1 BUS"
                default n

            config BSP_USING_SPI2
                bool "Enable SPI2 BUS"
                default n
        endif

    menuconfig BSP_USING_CAN
        bool "Enable CAN"
        select RT_USING_CAN
        default n
        if BSP_USING_CAN
            config BSP_USING_CAN1
            bool "Enable CAN1"
            default n

            config BSP_USING_CAN2
            bool "Enable CAN2"
            default n
        endif

    menuconfig BSP_USING_SDIO
        bool "Enable SDIO"
        select RT_USING_SDIO
        default n

    menuconfig BSP_USING_ETH
        bool "Enable ETH"
        default n

    menuconfig BSP_USING_USB_DEVICE
        bool "Enable USB Device"
        select RT_USING_USB_DEVICE
        default n

    menuconfig BSP_USING_USB_HOST
        bool "Enable USB Host"
        select RT_USING_USB_HOST
        default n

endmenu

menu "On-chip Peripheral Drivers"

endmenu

menu "Board extended module Drivers"

endmenu

endmenu
```
